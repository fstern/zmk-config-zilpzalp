#ifdef ZILPZALP_BLE_FLAG
#include <dt-bindings/zmk/bt.h>
#include <dt-bindings/zmk/outputs.h>
#endif

#include "base_zilpzalp.h"


// zilpzalp key numbers
//     __________________________  __________________________
//    /     0  |  1  |  2  |  3  \/   4 |   5 |   6 |   7    \
// |  8  |  9  | 10  | 11  | 12  /\  13 |  14 |  15 |  16 | 17  |
//    \    18  | 19  | 20    /        \    21 |  22 |  23   /
//          \    24  | 25  /            \  26 |  27    /
//           --------------              --------------

/ {

    keymap {
        compatible = "zmk,keymap";

        aptmak {
            label = "APT";

            bindings = <
                               &kp W          &kp E          &kp R          &kp T          &kp Y          &kp U          &kp I          &kp O
                &hl LCTRL A    &hl LALT S     &hl LGUI D     &hl LSHFT F    &hl RALT G     &hr RALT H     &hr RSHFT J    &hr RGUI K     &hr LALT L     &hr RCTRL P
                               &kp X          &kp C          &kp V                                        &kp M          &comsem        &dotcol
                                                             &my_lt NUM ESC &my_lt NAV SPACE &my_lt SYM RET  &my_lt FUN N
            >;
        };
        numbers {
            label = "NUM";

            bindings = <
                                  &none             &none                &none              &none          &kp KP_PLUS    &kp N7         &kp N8         &kp N9
                &hl LCTRL KP_PLUS &hl LALT KP_MINUS &hl LGUI KP_ASTERISK &hl LSHFT KP_SLASH &kp RALT       &kp KP_MINUS   &kp N4         &kp N5         &kp N6    &kp KP_SLASH
                                  &none             &none                &none                                            &kp N1         &kp N2         &kp N3
                                                             &trans         &trans         &kp RET          &kp N0
            >;
        };
        navigation {
            label = "NAV";

            bindings = <
                               &none          &kp PG_UP      &kp C_MUTE      &kp C_BRI_UP   &kp C_VOL_UP   &none          &kp UP         &kp PG_UP
                &sk LCTRL      &sk LALT       &sk LGUI       &sk LSHFT       &kp C_BRI_DN   &kp C_VOL_DN   &kp LEFT       &kp DOWN       &kp RIGHT         &kp TAB
                               &kp HOME       &kp PG_DN      &kp END                                       &kp BSPC       &kp DEL      &kp PG_DN
                                                             &trans          &trans         &trans         &trans
            >;
        };
        symbols {
            label = "SYM";

            bindings = <
                               &kp GRAVE      &kp DQT        &kp DOT          &kp LBKT       &kp RBKT       &kp BACKSLASH  &kp PIPE       &kp SLASH
                &kp EXCL       &kp AT         &kp HASH       &kp DOLLAR       &kp LPAR       &kp RPAR       &kp AMPERSAND  &kp ASTERISK   &kp PERCENT    &kp CARET
                               &kp TILDE      &kp SQT        &kp UNDERSCORE                                 &kp MINUS      &kp PLUS       &kp EQUAL
                                                             &kp LBRC         &kp RBRC       &trans         &trans
            >;
        };
#ifdef ZILPZALP_BLE_FLAG
        function {
            label = "FUN";

            bindings = <
                               &bootloader    &trans         &bt BT_CLR_ALL &bt BT_PRV     &kp F12        &kp F7         &kp F8         &kp F9
                &bootloader    &kp F12        &kp F11        &kp F10        &bt BT_NXT     &kp F11        &kp F4         &kp F5         &kp F6         &kp F10
                               &kp F9         &kp F8         &kp F7                                       &kp F1         &kp F2         &kp F3
                                                             &out OUT_TOG   &trans         &trans         &trans
            >;
#endif
#ifndef ZILPZALP_BLE_FLAG
        function {
            label = "FUN";

            bindings = <
                               &bootloader    &trans         &trans         &trans         &kp F12        &kp F7         &kp F8         &kp F9
                &bootloader    &kp F12        &kp F11        &kp F10        &trans         &kp F11        &kp F4         &kp F5         &kp F6         &kp F10
                               &kp F9         &kp F8         &kp F7                                       &kp F1         &kp F2         &kp F3
                                                             &trans         &trans         &trans         &trans
            >;
#endif
        };

    };
};

//     __________________________  __________________________
//    /     1  |  2  |  3  |  4  \/   5 |   6 |   7 |   8    \
// | 10  | 11  | 12  | 13  | 14  ||  15 |  16 |  17 |  18 | 19  |
//    \    20  | 21  | 22  |     ||     |  23 |  24 |  25   /
//                \    26  | 27  /\  28 |  29    /
//                 --------------  --------------
